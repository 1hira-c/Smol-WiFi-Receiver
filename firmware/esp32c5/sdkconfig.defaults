## firmware/esp32c5/sdkconfig.defaults
```kconfig
# SPDX-License-Identifier: MIT OR Apache-2.0
CONFIG_IDF_TARGET="esp32c5"
CONFIG_ESPTOOLPY_FLASHSIZE_8MB=y
CONFIG_PARTITION_TABLE_CUSTOM=y
CONFIG_PARTITION_TABLE_CUSTOM_FILENAME="partitions.csv"
CONFIG_FREERTOS_HZ=1000
CONFIG_ESP_SYSTEM_USE_FRAME_POINTER=y
CONFIG_ESP_WIFI_ENABLE_WPA3_SAE=y
CONFIG_ESP_WIFI_SOFTAP_SUPPORT=y
CONFIG_HTTPD_MAX_REQ_HDR_LEN=1024
CONFIG_HTTPD_MAX_URI_LEN=256
CONFIG_LOG_DEFAULT_LEVEL_INFO=y
```

## firmware/esp32c5/test_apps/protocol/sdkconfig.defaults
```kconfig
# SPDX-License-Identifier: MIT OR Apache-2.0
CONFIG_IDF_TARGET="esp32c5"
CONFIG_UNITY_ENABLE_FLOAT=y
```

## tests/zephyr/testcase.yaml
```yaml
# SPDX-License-Identifier: MIT OR Apache-2.0
tests:
  smol.protocol:
    platform_allow:
      - native_sim
    tags:
      - smol
      - protocol
```

## west.yml
```yaml
# SPDX-License-Identifier: MIT OR Apache-2.0
manifest:
  version: "1.2"
  projects:
    - name: sdk-nrf
      path: nrf
      url: https://github.com/nrfconnect/sdk-nrf.git
      revision: v3.3.1
      import: true
```
